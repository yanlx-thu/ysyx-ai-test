## ysyx-gpt-with-doc/nemu/configs/riscv32-native_defconfig
```kconfig
CONFIG_ISA_riscv=y
CONFIG_ENGINE_INTERPRETER=y
CONFIG_MODE_SYSTEM=y
CONFIG_TARGET_NATIVE_ELF=y
CONFIG_CC_GCC=y
CONFIG_CC_O2=y
CONFIG_TRACE=y
CONFIG_ITRACE=y
CONFIG_MBASE=0x80000000
CONFIG_MSIZE=0x8000000
CONFIG_PMEM_MALLOC=y
CONFIG_DEVICE=y
CONFIG_HAS_SERIAL=y
CONFIG_SERIAL_MMIO=0xa00003f8
CONFIG_HAS_TIMER=y
CONFIG_RTC_MMIO=0xa0000048
CONFIG_HAS_KEYBOARD=y
CONFIG_I8042_DATA_MMIO=0xa0000060
CONFIG_HAS_VGA=y
CONFIG_FB_ADDR=0xa1000000
CONFIG_VGA_CTL_MMIO=0xa0000100
CONFIG_VGA_SHOW_SCREEN=y
CONFIG_RT_CHECK=y
```
